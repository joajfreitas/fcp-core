VERSION ""

NS_ :

BS_:

BU_:

BO_ 10 Pedals: 2 Vector__XXX
 SG_ brak_pos : 8|8@1+ (1,0) [0|0] "" Vector__XXX
 SG_ acc_pos : 0|8@1+ (1,0) [0|0] "" Vector__XXX

BO_ 11 CellVoltage: 3 Vector__XXX
 SG_ voltage m0 : 8|16@1+ (1,0) [0|0] "" Vector__XXX
 SG_ mux M : 0|8@1+ (1,0) [0|0] "" Vector__XXX

SG_MUL_VAL_ 11 voltage mux 0-3;
