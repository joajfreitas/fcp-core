BO_ 10 Bar: 6 Vector__XXX
 SG_ s1_1 : 24|24@1+ (1,0) [0|0] "" Vector__XXX
 SG_ s1_0 : 0|24@1+ (1,0) [0|0] "" Vector__XXX
