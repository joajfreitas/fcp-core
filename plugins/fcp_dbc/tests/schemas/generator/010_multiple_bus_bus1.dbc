BO_ 10 Foo: 4 Vector__XXX
 SG_ s2 : 16|16@1+ (1,0) [0|0] "m/s^2" Vector__XXX
 SG_ s1 : 0|16@1+ (1,0) [0|0] "m/s" Vector__XXX
