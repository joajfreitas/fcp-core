BO_ 10 Foo: 2 Vector__XXX
 SG_ s2 : 8|8@1+ (1,0) [0|0] "C" Vector__XXX
 SG_ s1 : 0|8@1+ (1,0) [0|0] "m/s" Vector__XXX
