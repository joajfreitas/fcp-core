BO_ 10 Foo: 2 Vector__XXX
 SG_ s2 : 15|8@0+ (1,0) [0|0] "" Vector__XXX
 SG_ s1 : 0|8@1+ (1,0) [0|0] "" Vector__XXX
